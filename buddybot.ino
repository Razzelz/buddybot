#include<Arduino.h>
#include<IRremote.h>
#include "SD.h"
#define SD_ChipSelectPin 2
#include "TMRpcm.h"
#include "SPI.h"
#include <SPI.h>
#include <Wire.h>
#include <Adafruit_GFX.h>
#include <Adafruit_SSD1306.h>

TMRpcm tmrpcm;
#define IR_RECEIVE_PIN 11

//Initalize OLED screen
#define OLED_RESET    -1
#define SCREEN_WIDTH  128
#define SCREEN_HEIGHT 64
Adafruit_SSD1306 display(SCREEN_WIDTH, SCREEN_HEIGHT, &Wire, OLED_RESET);


int motor1pin1 = 4;
int motor1pin2 = 5;

int motor2pin1 = 8;
int motor2pin2 = 9;

int redPin = 3;
int greenPin = 5;
int bluePin = 6;

void setColor(int red, int green, int blue) {
  analogWrite(redPin, red);
  analogWrite(greenPin, green);
  analogWrite(bluePin, blue);  
}

void setTalkingDisplay() {
  const unsigned char look_talking[] PROGMEM = {
  0x00, 0x00, 0x00, 0x00, 0x00, 0x00, 0x00, 0x00, 0x00, 0x00, 0x00, 0x00, 0x00, 0x00, 0x00, 0x00, 
  0x00, 0x00, 0x00, 0x00, 0x00, 0x00, 0x00, 0x00, 0x00, 0x00, 0x00, 0x00, 0x00, 0x00, 0x00, 0x00, 
  0x00, 0x00, 0x00, 0x00, 0x00, 0x00, 0x00, 0x00, 0x00, 0x00, 0x00, 0x00, 0x00, 0x00, 0x00, 0x00, 
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  0x00, 0x00, 0x00, 0x00, 0x00, 0x00, 0x00, 0x00, 0x00, 0x00, 0x00, 0x00, 0x00, 0x00, 0x00, 0x00
  };
  display.clearDisplay();
  display.drawBitmap(0, 0, look_talking, SCREEN_WIDTH, SCREEN_HEIGHT, WHITE);
  display.display();
}

void setForwardDisplay() {
  const unsigned char look_forward[] PROGMEM = {
  0x00, 0x00, 0x00, 0x00, 0x00, 0x00, 0x00, 0x00, 0x00, 0x00, 0x00, 0x00, 0x00, 0x00, 0x00, 0x00, 
  0x00, 0x00, 0x00, 0x00, 0x00, 0x00, 0x00, 0x00, 0x00, 0x00, 0x00, 0x00, 0x00, 0x00, 0x00, 0x00, 
  0x00, 0x00, 0x00, 0x00, 0x00, 0x00, 0x00, 0x00, 0x00, 0x00, 0x00, 0x00, 0x00, 0x00, 0x00, 0x00, 
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  0x00, 0x00, 0x00, 0x00, 0x00, 0x00, 0x00, 0x00, 0x00, 0x00, 0x00, 0x00, 0x00, 0x00, 0x00, 0x00
  };
  display.clearDisplay();
  display.drawBitmap(0, 0, look_forward, SCREEN_WIDTH, SCREEN_HEIGHT, WHITE);
  display.display();
}


void setSingingDisplay() {
  const unsigned char look_singing[] PROGMEM = {
  0x00, 0x00, 0x00, 0x00, 0x00, 0x00, 0x00, 0x00, 0x00, 0x00, 0x00, 0x00, 0x00, 0x00, 0x00, 0x00, 
  0x00, 0x00, 0x00, 0x00, 0x00, 0x00, 0x00, 0x00, 0x00, 0x00, 0x00, 0x00, 0x00, 0x00, 0x00, 0x00, 
  0x00, 0x00, 0x00, 0x00, 0x00, 0x00, 0x00, 0x00, 0x00, 0x00, 0x00, 0x00, 0x00, 0x00, 0x00, 0x00, 
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  0x00, 0x00, 0x00, 0x00, 0x00, 0x00, 0x00, 0x00, 0x00, 0x00, 0x00, 0x00, 0x00, 0x00, 0x00, 0x00
  };
  display.clearDisplay();
  display.drawBitmap(0, 0, look_singing, SCREEN_WIDTH, SCREEN_HEIGHT, WHITE);
  display.display();
}


void Left() {
  digitalWrite(motor1pin1, LOW);
  digitalWrite(motor1pin2, HIGH);
  digitalWrite(motor2pin1, LOW);
  digitalWrite(motor2pin2, HIGH);
}

void Right() {
  digitalWrite(motor1pin1, HIGH);
  digitalWrite(motor1pin2, LOW);
  digitalWrite(motor2pin1, HIGH);
  digitalWrite(motor2pin2, LOW);
}

void Forward() {
  digitalWrite(motor1pin1, LOW);
  digitalWrite(motor1pin2, HIGH);
  digitalWrite(motor2pin1, HIGH);
  digitalWrite(motor2pin2, LOW);
}

void Backward() {
  digitalWrite(motor1pin1, HIGH);
  digitalWrite(motor1pin2, LOW);
  digitalWrite(motor2pin1, LOW);
  digitalWrite(motor2pin2, HIGH);
}

void Stop() {
  digitalWrite(motor1pin1, LOW);
  digitalWrite(motor1pin2, LOW);
  digitalWrite(motor2pin1, LOW);
  digitalWrite(motor2pin2, LOW);
}

void setup () {

  //Check if IR sensor is detected
  Serial.begin (115200);
  Serial.println(F("START " __FILE__ " from " __DATE__ "\r\nUsing library version " VERSION_IRREMOTE));
  IrReceiver.begin(IR_RECEIVE_PIN, ENABLE_LED_FEEDBACK, USE_DEFAULT_FEEDBACK_LED_PIN);
  Serial.print(F("Ready to receive IR signals at pin "));
  Serial.println(IR_RECEIVE_PIN);

  //Check if display is detected
  if (!display.begin(SSD1306_SWITCHCAPVCC, 0x3C)) {
    Serial.println(F("SSD1306 allocation failed"));
  }

  //Initalize speaker and detect SD card reader
  tmrpcm.speakerPin = 10;
  Serial.begin(9600);
  if (!SD.begin(SD_ChipSelectPin)) {
    Serial.println("SD fail");
    return;
  }
  pinMode(motor1pin1, OUTPUT);
  pinMode(motor1pin2, OUTPUT);
  pinMode(motor2pin1, OUTPUT);
  pinMode(motor2pin2, OUTPUT);

  pinMode(redPin, OUTPUT);
  pinMode(greenPin, OUTPUT);
  pinMode(bluePin, OUTPUT);
  
}


void loop() {
  //Set Display
  setForwardDisplay();
  if (IrReceiver.decode()) {
    IrReceiver.printIRResultShort(&Serial);
    if (IrReceiver.decodedIRData.protocol == UNKNOWN) {
      IrReceiver.printIRResultRawFormatted(&Serial, true);
    }

    switch(IrReceiver.decodedIRData.command) {
      //Hitting the 1 button
      case 0x45:
      Serial.println("RC Mode");
        switch(IrReceiver.decodedIRData.command) {
          case 0x18 :
          Serial.println("Move Forward");
          Forward();
          break;
          case 0x52:
          Serial.println("Move Backward");
          Backward();
          break;
          case 0x8:
          Serial.println("Turn Left");
          Left();
          break;
          case 0x5A:
          Serial.println("Turn Right");
          Right();
          break;
          case 0x1C:
          Serial.println("Stop");
          Stop();
          break;
        }
     case 0x46:
     //Set Display
     setSingingDisplay();
     
     //Start music
     Serial.println("Dance Mode");
     tmrpcm.setVolume(5);
     tmrpcm.play("music.wav");

     //Flash light
     setColor(255, 0, 0);  // red
     delay(1000);
     setColor(0, 255, 0);  // green
     delay(1000);
     setColor(0, 0, 255);  // blue
     delay(1000);
     setColor(255, 255, 0);  // yellow
     delay(1000);  
     setColor(80, 0, 80);  // purple
     delay(1000);
     setColor(255, 50, 0);  // Orange
     delay(1000);
     break;

    case 0x47:
    //Set Display
    setTalkingDisplay();
    
    //Start talking
    Serial.println("Talk Mode");
    tmrpcm.setVolume(5);
    tmrpcm.play("quote.wav");

    randomSeed(analogRead(0));

    //Random a delay between 2 and 5 min
    int randomDelay = random(2 * 60 * 1000, 5 * 60 * 1000);
    delay(randomDelay);

    tmrpcm.play("funfact.wav");
    break;
    
  Serial.println();
  IrReceiver.resume();
    }
  }
}
